## config/west.yml
```yaml
manifest:
  remotes:
    - name: zmkfirmware
      url-base: https://github.com/zmkfirmware
    - name: kumamuk-git
      url-base: https://github.com/kumamuk-git
    - name: caksoylar
      url-base: https://github.com/caksoylar
    - name: badjeff
      url-base: https://github.com/badjeff
    - name: kot149
      url-base: https://github.com/kot149
  projects:
    - name: zmk
      remote: zmkfirmware
      revision: abb64ba316c29caddc49727ca2cac2f0ed5970c7
      import: app/west.yml
#    - name: zmk-pmw3610-driver
#      remote: kumamuk-git
#      revision: main
    # https://github.com/badjeff/zmk-pmw3610-driver
    - name: zmk-pmw3610-driver
      remote: badjeff
      revision: zmk-0.3
      path: modules/zmk-pmw3610-driver-badjeff
    # https://github.com/kot149/zmk-scroll-snap
    - name: zmk-scroll-snap
      remote: kot149
      revision: v1
      path: modules/zmk-scroll-snap
  self:
    path: config
```
